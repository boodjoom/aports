// SPDX-License-Identifier: (GPL-2.0-or-later OR MIT)
/*
 * Copyright 2018 TQ Systems GmbH
 * Author: Markus Niebel <Markus.Niebel@tq-group.com>
 */

#include "tq-imx6ul-mba6ulx.dts"
#include "tq-imx6ul-mba6ul-lcdif.dtsi"
#include "tq-imx6ul-mba6ul-lvds.dtsi"
